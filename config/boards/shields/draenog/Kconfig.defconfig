## config/boards/shields/draenog/Kconfig.defconfig
```kconfig
if SHIELD_DRAENOG_LEFT

config ZMK_KEYBOARD_NAME
    default "Draenog"

config ZMK_SPLIT_ROLE_CENTRAL
    default y

endif

if SHIELD_DRAENOG_LEFT || SHIELD_DRAENOG_RIGHT

config ZMK_SPLIT
    default y
```

## config/boards/shields/draenog/Kconfig.shield
```kconfig
# Copyright (c) 2020 The ZMK Contributors
# SPDX-License-Identifier: MIT

config SHIELD_DRAENOG_LEFT
    def_bool $(shields_list_contains,draenog_left)

config SHIELD_DRAENOG_RIGHT
    def_bool $(shields_list_contains,draenog_right)
```
